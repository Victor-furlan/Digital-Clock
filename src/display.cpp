#include <TFT_eSPI.h>
#include <qrcode.h>
#include <RTClib.h>
#include "display.h"
#include "config.h"
#include "rtc.h"

TFT_eSPI tft = TFT_eSPI();

static const uint16_t PROGMEM image_paint_1_pixels[] = {0x0000,0x0000,0xFFFF,0xFFFF,0xFFFF,0xFFFF,0x0000,0x0000,0x0000,0x0000,0x0000,0x0000,0x0000,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0x0000,0x0000};

static bool indexInitialized = false;

static String getIconLabel(String icon) {
    if (icon.indexOf("💼") != -1 || icon.indexOf("trabalho") != -1) return "[TRABALHO]";
    if (icon.indexOf("💊") != -1 || icon.indexOf("remedio") != -1 || icon.indexOf("remédio") != -1) return "[REMEDIO]";
    if (icon.indexOf("🏋") != -1 || icon.indexOf("exercicio") != -1 || icon.indexOf("exercício") != -1) return "[TREINO]";
    if (icon.indexOf("📚") != -1 || icon.indexOf("estudo") != -1) return "[ESTUDO]";
    if (icon.indexOf("☕") != -1 || icon.indexOf("cafe") != -1 || icon.indexOf("café") != -1) return "[CAFE]";
    if (icon.indexOf("🔔") != -1 || icon.indexOf("geral") != -1) return "[GERAL]";
    if (icon.length() > 0) return "[" + icon + "]";
    return "[ALARME]";
}

void handleSplash() {
    tft.init();
    tft.setRotation(1);
    tft.fillScreen(TFT_BLACK);

    // Ícone centralizado (33x33) — centro da tela 320x240
    tft.pushImage(143, 60, 33, 33, image_paint_1_pixels);

    // Texto abaixo do ícone
    tft.setTextColor(TFT_CYAN, TFT_BLACK);
    tft.setTextDatum(MC_DATUM);
    tft.setTextSize(2);
    tft.drawString("Relogio Smart", 160, 120);
    
    tft.setTextColor(TFT_YELLOW, TFT_BLACK);
    tft.setTextSize(2);
    tft.drawString("Conectando ao Wi-Fi...", 160, 160);
    indexInitialized = false;
}

void handleWelcome() {
    tft.fillScreen(TFT_BLACK);

    tft.setTextColor(TFT_GREEN, TFT_BLACK);
    tft.setTextDatum(MC_DATUM);
    tft.setTextSize(3);
    tft.drawString("Seja Bem-Vindo!", 160, 120);
    indexInitialized = false;
}

void handleQrCode(String ip) {
    tft.fillScreen(TFT_WHITE);
    
    QRCode qrcode;
    uint8_t qrcodeData[qrcode_getBufferSize(3)];
    qrcode_initText(&qrcode, qrcodeData, 3, 0, ip.c_str());

    int modSize = 4;
    int qrSize = qrcode.size * modSize;
    int offsetX = (320 - qrSize) / 2;
    int offsetY = (240 - qrSize) / 2 - 15;

    for (int y = 0; y < qrcode.size; y++)
    {
        for (int x = 0; x < qrcode.size; x++)
        {
            uint16_t cor = qrcode_getModule(&qrcode, x, y) ? TFT_BLACK : TFT_WHITE;
            tft.fillRect(offsetX + x * modSize, offsetY + y * modSize, modSize, modSize, cor);
        }
    }

    tft.setTextColor(TFT_BLACK, TFT_WHITE);
    tft.setTextDatum(MC_DATUM);
    tft.setTextSize(2);
    tft.drawString("IP: " + ip, 160, offsetY + qrSize + 22);
    indexInitialized = false;
}

void handleIndex(DateTime hora, Alarme alarmes[]) {
    String h = hora.hour() < 10 ? "0" + String(hora.hour()) : String(hora.hour());
    String m = hora.minute() < 10 ? "0" + String(hora.minute()) : String(hora.minute());
    String s = hora.second() < 10 ? "0" + String(hora.second()) : String(hora.second());
    String horaStr = h + ":" + m + ":" + s;

    String d = hora.day() < 10 ? "0" + String(hora.day()) : String(hora.day());
    String mes = hora.month() < 10 ? "0" + String(hora.month()) : String(hora.month());
    String a = String(hora.year());
    String dataHoje = d + "/" + mes + "/" + a;

    bool temAlarme = false;
    String nomeAlarme = "";
    String iconeAlarme = "";
    int horaAlarme = 0;
    int minAlarme = 0;

    for (int i = 0; i < 3; i++)
    {
        if (alarmes[i].ativo)
        {
            nomeAlarme = alarmes[i].nome;
            iconeAlarme = alarmes[i].icone;
            horaAlarme = alarmes[i].hora;
            minAlarme = alarmes[i].minuto;
            temAlarme = true;
            break;
        }
    }

    String hA = horaAlarme < 10 ? "0" + String(horaAlarme) : String(horaAlarme);
    String mA = minAlarme < 10 ? "0" + String(minAlarme) : String(minAlarme);
    String horarioAlarmeStr = hA + ":" + mA;

    // Se for o primeiro desenho do Index, limpa tela e desenha moldura fixa
    if (!indexInitialized) {
        tft.fillScreen(TFT_BLACK);
        tft.pushImage(10, 5, 33, 33, image_paint_1_pixels);
        
        tft.setTextColor(TFT_CYAN, TFT_BLACK);
        tft.setTextDatum(TL_DATUM);
        tft.setTextSize(2);
        tft.drawString("Relogio Smart", 52, 14);

        tft.drawFastHLine(0, 42, 320, TFT_DARKGREY);
        tft.drawFastHLine(0, 140, 320, TFT_DARKGREY);
        
        tft.setTextColor(TFT_ORANGE, TFT_BLACK);
        tft.setTextDatum(MC_DATUM);
        tft.setTextSize(2);
        tft.drawString("PROXIMO ALARME:", 160, 160);

        indexInitialized = true;
    }

    // Atualiza Hora (HH:MM:SS) - TextSize 4
    tft.setTextColor(TFT_WHITE, TFT_BLACK);
    tft.setTextDatum(MC_DATUM);
    tft.setTextSize(4);
    tft.drawString(horaStr, 160, 75);

    // Atualiza Data (DD/MM/AAAA) - TextSize 2 (Amarela)
    tft.setTextColor(TFT_YELLOW, TFT_BLACK);
    tft.setTextDatum(MC_DATUM);
    tft.setTextSize(2);
    tft.drawString(dataHoje, 160, 115);

    // Atualiza Info Alarme - TextSize 2 (Verde)
    tft.setTextSize(2);
    if (temAlarme) {
        String infoText = getIconLabel(iconeAlarme) + " " + nomeAlarme + " - " + horarioAlarmeStr;
        tft.setTextColor(TFT_GREEN, TFT_BLACK);
        tft.drawString(infoText, 160, 195);
    } else {
        tft.setTextColor(TFT_DARKGREY, TFT_BLACK);
        tft.drawString("Nenhum alarme ativo", 160, 195);
    }
}

void handleAlarm(Alarme alarme) {
    indexInitialized = false;
    String hA = alarme.hora < 10 ? "0" + String(alarme.hora) : String(alarme.hora);
    String mA = alarme.minuto < 10 ? "0" + String(alarme.minuto) : String(alarme.minuto);
    String strHorario = hA + ":" + mA;

    tft.fillScreen(TFT_PURPLE);
    tft.pushImage(10, 10, 33, 33, image_paint_1_pixels);
    
    tft.setTextColor(TFT_YELLOW, TFT_PURPLE);
    tft.setTextDatum(MC_DATUM);
    tft.setTextSize(3);
    tft.drawString("!!! ALARME !!!", 160, 45);

    tft.setTextColor(TFT_WHITE, TFT_PURPLE);
    tft.setTextSize(3);
    String labelAlarme = getIconLabel(alarme.icone) + " " + alarme.nome;
    tft.drawString(labelAlarme, 160, 105);

    tft.setTextSize(6);
    tft.drawString(strHorario, 160, 165);

    tft.setTextColor(TFT_YELLOW, TFT_PURPLE);
    tft.setTextSize(2);
    tft.drawString("Toque no sensor para desligar", 160, 215);
}